#include <input/processors.dtsi>

&zip_temp_layer {
    require-prior-idle-ms = <500>;
};

&pointing_listener {
    status = "okay";
    device = <&pointing_device>;

    input-processors =
        <&zip_xy_transform (INPUT_TRANSFORM_X_INVERT | INPUT_TRANSFORM_Y_INVERT)>,
        <&zip_xy_scaler 3 4>,
        <&zip_temp_layer 1 700>;

    scroll_layer {
        layers = <4>;

        input-processors =
            <&zip_xy_scaler 1 6>,
            <&zip_xy_to_scroll_mapper>,
            <&zip_scroll_transform INPUT_TRANSFORM_X_INVERT>;
    };
};
